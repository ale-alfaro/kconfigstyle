## examples/Kconfig.bad
```kconfig
#Bad comment formatting
config BadLowercase
  bool "This uses spaces not tabs"
  help
   Help text with wrong indentation

config ANOTHER_CONFIG
	bool "This is fine"
	help
	  But there are trailing spaces above and this line is way too long to fit within the 100 character limit for Zephyr style
config MISSING_SPACING
	bool "No empty line before this"
```

## examples/Kconfig.espidf
```kconfig
menu "Network Configuration"
    config NETWORKING_ENABLED
        bool "Enable networking"
        default y
        help
            Enable network stack support for the application.
            This provides TCP/IP connectivity.

    config NET_IPV4_SUPPORT
        bool "IPv4 support"
        depends on NETWORKING_ENABLED
        default y
        help
            Enable IPv4 protocol support.

    config NET_IPV6_SUPPORT
        bool "IPv6 support"
        depends on NETWORKING_ENABLED
        default n
        help
            Enable IPv6 protocol support.
endmenu

menu "Advanced Options"
    config ADV_FEATURE_ENABLED
        bool "Enable advanced features"
        default n
        help
            Enable advanced feature set.

    config ADV_TIMEOUT
        int "Timeout value"
        depends on ADV_FEATURE_ENABLED
        range 0 1000
        default 100
        help
            Configure the timeout value in milliseconds.
endmenu
```

## examples/Kconfig.zephyr
```kconfig
# Zephyr-style Kconfig example

config NETWORKING
	bool "Enable networking"
	help
	  Enable network stack support for the application.
	  This provides TCP/IP connectivity.

config NET_IPV4
	bool "IPv4 support"
	depends on NETWORKING
	help
	  Enable IPv4 protocol support.

config NET_IPV6
	bool "IPv6 support"
	depends on NETWORKING
	help
	  Enable IPv6 protocol support.

if ADVANCED_FEATURES

config FEATURE_X
	bool "Feature X"
	help
	  Enable advanced feature X.

endif

menu "Advanced Options"

config ADVANCED_OPTION_1
	int "Advanced option 1"
	default 42
	help
	  Configure advanced option 1.

endmenu
```
